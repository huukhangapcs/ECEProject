ORG 0H
JMP MAIN
ORG 0BH
    MOV TH0,0D8H
    MOV TL0,0EFH
    INC R0
    RETI
GREEN_1 EQU 30H
RED_1  EQU 33H
GREEN_2 EQU 36H
RED_2   EQU 39H
YELLOW   EQU 42H
IR1 BIT P3.4
DR1 BIT P3.5
IR2 BIT P3.6
DR2 BIT P3.7
SETUP BIT P0.7
DONE BIT P0.6
MAIN:
    MOV TMOD,#01; dinh thoi mode 0
    MOV TH0,#3CH
    MOV TL0,#0AFH
    CLR TF0
    SETB TR0
    MOV IE,#82H
START: 
	CLR IR1
	CLR IR2
	CLR DR1
	CLR DR2
    MOV GREEN_1,#15
    MOV RED_1,#27
    MOV GREEN_2,#24
    MOV RED_2,#18
    MOV YELLOW,#3; red2 = green2 + 3, red2 = green1+3
START_2:
	MOV P0,#21H   ;xuat led do2 xanh1
	MOV R1,GREEN_1
    MOV R2,RED_2
LOOP_MODE_1:CALL MODE_1
	CALL SET_PRESSED
	DEC R2
    DJNZ R1,LOOP_MODE_1
    MOV P0,#22H  ;xuat led vang sang
    MOV R1,YELLOW
LOOP_2: 
	MOV R0,#0
    CALL BCD_CONVERTER
AGAIN_2: 
    CALL DISPLAY
    CJNE R0,#20,again_2
    DEC R2
    DJNZ R1,loop_2
    MOV P0,#0CH      ;xuat led xanh2 do 1 sang
	MOV R1, RED_1
    MOV R2,GREEN_2
LOOP_MODE_2:CALL MODE_2
	CALL SET_PRESSED
	DEC R1
    DJNZ R2,LOOP_MODE_2
    MOV P0,#14H         ;vang2 sang
    MOV R2,YELLOW
LOOP_4:
    MOV R0,#0
    CALL BCD_CONVERTER
AGAIN_4:   
    CALL DISPLAY
    CJNE R0,#20,again_4
    DEC R2
    DJNZ R1,loop_4
    JMP START_2

BCD_CONVERTER: ;DUNG DE HIEN THI HANG CHUC, HANG DON VI
    MOV A,R1
    MOV B,#10
    DIV AB
    MOV 50H,A
    MOV 51H,B
                                                  
    MOV A,R2
    MOV B,#10
    DIV AB
    MOV 52H,A
    MOV 53H,B
    RET
DISPLAY:
    MOV DPTR,#LCD_CODE
    MOV A,50H
    MOVC A,@A+DPTR
    MOV P2,A
    MOV P3,#01H
    CALL delay
    MOV P3,#00H // CHONG LEM

    MOV A,51H
    MOVC A,@A+DPTR
    MOV P2,A
    MOV P3,#02H
    CALL delay
    MOV P3,#00H

    MOV A,52H
    MOVC A,@A+DPTR
    MOV P1,A
    MOV P3,#04H
    CALL delay
    MOV P3,#00H
    
    MOV A,53H
	MOVC A,@A+DPTR
    MOV P1,A
    MOV P3,#08H
    CALL delay
    MOV P3,#00H
	RET
;*****************************************************
MODE_1:
    MOV R0,#0
    CALL BCD_CONVERTER
AGAIN_1:
	CALL SET_PRESSED
    CALL DISPLAY
    CJNE R0,#20,AGAIN_1
	RET
;*****************************************************
MODE_2: 
    MOV R0,#0
    CALL BCD_CONVERTER
AGAIN_3:
	CALL SET_PRESSED
    CALL DISPLAY
    CJNE R0,#20,AGAIN_3
    
RET
MODE_3:
	MOV P0,#24H ; 2 DEN DO
	CALL BCD_CONVERTER
    CALL DISPLAY
	RET
;******************************************************
SET_PRESSED:
	JB SETUP, SETTING
	MOV R5, #0
	RET
SETTING:
	MOV R1,RED_1
    MOV R2,RED_2
	CALL DELAY_LONG
	CALL DELAY_LONG
	LOOP_SETTING:
	JB IR1, INC_RED_1
	JB DR1, DEC_RED_1
	JB IR2, INC_RED_2
	JB DR2, DEC_RED_2
	CALL MODE_3
	JNB DONE, LOOP_SETTING
	JMP START_2
	RET
INC_RED_1:
	CALL DELAY_LONG
	CALL DELAY_LONG
	CALL DELAY_LONG
	CALL DELAY_LONG
	CALL DELAY_LONG
	MOV A, RED_1
	SUBB A, #2
	MOV GREEN_2, A
	ADD A, #3
	MOV RED_1, A
	JMP SETTING
DEC_RED_1:
	CALL DELAY_LONG
	CALL DELAY_LONG
	CALL DELAY_LONG
	CALL DELAY_LONG
	CALL DELAY_LONG
	MOV A, RED_1
	SUBB A, #4
	MOV GREEN_2, A
	ADD A, #3
	MOV RED_1, A
	JMP SETTING
RET
INC_RED_2:
	CALL DELAY_LONG
	CALL DELAY_LONG
	CALL DELAY_LONG
	CALL DELAY_LONG
	CALL DELAY_LONG
	MOV A, RED_2
	SUBB A, #2
	MOV GREEN_1, A
	ADD A, #3
	MOV RED_2, A
	JMP SETTING
RET
DEC_RED_2:
	CALL DELAY_LONG
	CALL DELAY_LONG
	CALL DELAY_LONG
	CALL DELAY_LONG
	CALL DELAY_LONG
	MOV A, RED_2
	SUBB A, #4
	MOV GREEN_1, A
	ADD A, #3
	MOV RED_2, A
	JMP SETTING
RET
;*****************************************************
DELAY:  MOV R6,#90
LOOP:   DJNZ R6,LOOP
        RET

DELAY_LONG:
	MOV R7, #250
	LOOP_LONG:
		CALL DELAY
		DJNZ R7, LOOP_LONG
		RET
LCD_CODE:
DB  0C0H,0F9H,0A4H,0B0H,99H,92H,82H,0F8H,80H,90H
end